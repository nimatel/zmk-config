## config/west.yml
```yaml
manifest:
  remotes:
    #- name: zmkfirmware
    #  url-base: https://github.com/zmkfirmware
    - name: infused-kim
      url-base: https://github.com/infused-kim
  projects:
  # - name: zmk
    #   remote: zmkfirmware
    #   revision: main
    #   import: app/west.yml
    ame: zmk-zephyr
      remote: infused-kim
      revision: v2.5.0+zmk-fixes+kim-fixes
      clone-depth: 1
  self:
    path: config
```
